## sdkconfig.defaults
```kconfig
# Default sdkconfig parameters to use the OTA
# partition table layout, with a 4MB flash size
CONFIG_ESPTOOLPY_FLASHSIZE_4MB=y
CONFIG_PARTITION_TABLE_TWO_OTA=y

# Certificate bundle configuration
CONFIG_EXAMPLE_USE_CERT_BUNDLE=n
CONFIG_MBEDTLS_CERTIFICATE_BUNDLE_DEFAULT_CMN=y
CONFIG_EXAMPLE_SKIP_COMMON_NAME_CHECK=y
# make code chose .cert_pem = (char *)server_cert_pem_start path
CONFIG_MBEDTLS_CUSTOM_CERTIFICATE_BUNDLE=n
#CONFIG_MBEDTLS_CUSTOM_CERTIFICATE_BUNDLE_PATH="server_certs/ca_cert.pem"
```
